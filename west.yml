## west.yml
```yaml
manifest:
  self:
    path: realtek-zephyr-project

  remotes:
    - name: rtkconnectivity
      url-base: https://github.com/rtkconnectivity

  projects:
    - name: zephyr
      remote: rtkconnectivity
      revision: realtek-main-v3.7
      import:
        name-allowlist:
          - cmsis
          - hal_realtek
          - tinycrypt
          - openthread
          - mbedtls
    - name: connectedhomeip
      remote: project-chip
      repo-path: connectedhomeip
      path: modules/lib/connectedhomeip
      revision: master

  self:
    west-commands: tool/west-commands.yml
```
